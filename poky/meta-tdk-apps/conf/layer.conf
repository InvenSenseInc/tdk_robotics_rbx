## poky/meta-tdk-apps/conf/layer.conf
```bitbake
BBPATH .= ":${LAYERDIR}"
BBFILES += "${LAYERDIR}/recipes/*/*.bb ${LAYERDIR}/recipes/*/*.bbappend ${LAYERDIR}/recipes-*/*/*.bb ${LAYERDIR}/recipes-*/*.bbappend"

BBFILE_COLLECTIONS += "meta-tdk-apps"
BBFILE_PATTERN_meta-tdk-apps := "^${LAYERDIR}/"
BBFILE_PRIORITY_meta-tdk-apps = "8"
```

## poky/meta-tdk-fw/conf/layer.conf
```bitbake
# We have a conf and classes directory, append to BBPATH
BBPATH .= ":${LAYERDIR}"

# We have recipes-* directories, add to BBFILES
BBFILES += "${LAYERDIR}/recipes-*/*/*.bb \
${LAYERDIR}/recipes-*/*/*.bbappend \
${LAYERDIR}/recipes-*/*.bb \
${LAYERDIR}/recipes-*/*.bbappend "

BBFILE_COLLECTIONS += "tdk-fw"
BBFILE_PATTERN_tdk-fw = "^${LAYERDIR}/"
BBFILE_PRIORITY_tdk-fw = "6"
LAYERVERSION_tdk-fw = "1"
```
